#include <avr/eeprom.h>

//starage for ADSR envelope
char adsr[16][4];
//wave shape parameters
char wavePar[8];
//interpolated signed wave samples
char wave[256];

//!!!!! comment in next line for graphics on the oscilloscope
//#define GRAPHICS 

#ifdef GRAPHICS
#include "osciGraphics.h"
#endif

#include "fixedPoint.h"

//this frequency table is for 44100Hz
const unsigned long freqIncTab[] PROGMEM = {796254, 843601, 893765, 946911, 1003217, 1062871, 1126073, 1193033, 1263974, 1339134, 1418763, 1503127, 1592507,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 1153098554, 1221665363};
const unsigned char compressTab[] PROGMEM = {1, 1, 1, 1, 1, 1, 1, 1, 1, 1, 1, 1, 1,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 255, 255};
//~reciprocal look up table
const unsigned short rcp[] PROGMEM =  {65535, 32767, 21844, 16383, 13106, 10922, 9361, 8191, 7281, 6553, 5957, 5460, 5040,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 515, 511};

char noteMap[16][128];
#define MAX_NOTES 8

class Note
{
  public:
  unsigned char channel;
  unsigned char note;
  char state;
  //fixed point precalculated parameters
  uf8p24 phase;
  uf8p24 freqInc;
  uf8p24 envelopePhase;
  uf0p16 envelopePhaseIncA;
  uf0p16 envelopePhaseIncD;
  uf0p16 envelopePhaseIncR;
  uf0p8 envelopeAmpS;
  uf0p8 envelopeAmpR;
  uf0p8 envelopeAmp;
  uf0p8 envelopeAmpDeltaS;
  uf0p8 envelopeAmpDeltaA;
  uf0p8 velocity;
  uf0p8 envelopeAmpA;
  
  Note()
  {
    state = -1;
    envelopeAmp = 0;
  }

  void setEnvelope(unsigned char v)
  {
    velocity = (v << 1) + 1;     //scale velocity to [1 - 255]
    //precalculate values
    //each envelope phase counts for 65536 steps (16 bit). the actual time they take is resulting from the increment we count up to thes value
    //the upper 8 bits of the envelope phase indicate in which region of ADSR we are
    envelopePhase = 0;
    envelopePhaseIncA = pgm_read_word(&rcp[adsr[channel][0]]);                         // 1/A
    envelopePhaseIncD = pgm_read_word(&rcp[adsr[channel][1]]);                         // 1/D
    envelopePhaseIncR = pgm_read_word(&rcp[adsr[channel][3]]);                         // 1/R
    envelopeAmpS = mul_uf0p8_uf0p8_uf0p8(velocity, (adsr[channel][2] << 1) + 1);       // S (scaled to 1 - 255) * velocity 
    envelopeAmpDeltaS = velocity - envelopeAmpS;       // delta between max amp
    envelopeAmpDeltaA = velocity - envelopeAmpA;       //delta from 0 or last amplitude if note is replayed 
  }

  void replay(unsigned char v)
  {
    cli();                       //can't interrupt while parameters are changing
    envelopeAmpA = envelopeAmp;  //start from current amplitude to avoid clicks
    setEnvelope(v);              //write new parameters
    sei();
  }
  
  void on(unsigned char ch, unsigned char n, unsigned char v)
  {
    //set note parameters
    channel = ch;
    note = n; 
    phase = 0;
    freqInc = pgm_read_dword(&freqIncTab[n]);
    freqInc <<= 2;  //have to quadruple the increment because of the we went down to a qarter of the frequency
    envelopeAmpA = 0;  //no playing atm start attack from 0
    setEnvelope(v);
    state = 0;  //set statte to plaing
  }
  
  void off()
  {
    cli();                        //not want to interrupt
    envelopeAmpR = envelopeAmp;   //save release amplitude
    if(envelopeAmpR)
      envelopePhase = 0x3000000;  //goto release
    else
      envelopePhase = 0x4000000;  //no relase phase
    sei();
  }
  
  char mix()
  {
    switch(cast_uf8p24_uf8p0(envelopePhase))    //upper 8bits of envelope pahse are taking to identify the phase
    {
      case 0:
        envelopeAmp = envelopeAmpA + mul_uf0p8_uf0p8_uf0p8(cast_uf8p24_uf0p8(envelopePhase), envelopeAmpDeltaA);  //ramping up during Attack pahse to velocity amp
        envelopePhase += envelopePhaseIncA;  //adding the increment. the higher the inc the shorter the attack period
        break;
      case 1:
        envelopeAmp = velocity - mul_uf0p8_uf0p8_uf0p8(cast_uf8p24_uf0p8(envelopePhase), envelopeAmpDeltaS);  //ramping decay down to sustain level
        envelopePhase += envelopePhaseIncD;  //same procedure her as in attack
        break;
      case 2:
        if(!envelopeAmpS)  //if sustain level is zerowe are done here, go to end
        {
          envelopePhase = 0x4000000;
          return 0;
        }
        envelopeAmp = envelopeAmpS;      //set the amplitude to calculated value othervise
        break;
      case 3:
        envelopeAmp = envelopeAmpR - mul_uf0p8_uf0p8_uf0p8(cast_uf8p24_uf0p8(envelopePhase), envelopeAmpR);  //ramp down the last aplitude we saved to zero during the relese pahse 
        envelopePhase += envelopePhaseIncR;  //same as above
        break;
      case 4:
        state = -1;              //done with the note, clear the states
        noteMap[channel][note] = -1;
        return 0;        
    }
    f8p0 s = 0;
    s = wave[cast_uf8p24_uf8p0(phase)];  //read the waveform from the table taking the high 8 bits of the time phase
    s = mul_f8p0_uf0p8_f8p0(s, envelopeAmp);  //mutliplying the wave by the amplutide calculated from the ADSR and velocity above
    phase += freqInc;  //increment the pahase of the wave freqency 
    return s;
  }
};

Note notes[MAX_NOTES];

void noteOff(byte ch, byte n, byte v) 
{
  if(noteMap[ch][n] >= 0)
    notes[noteMap[ch][n]].off();
}

void noteOn(byte ch, byte n, byte v) 
{
  if(!v)
    noteOff(ch, n, 0);
  else
    if(noteMap[ch][n] >= 0)
        notes[noteMap[ch][n]].replay(v);
    else
      for(char i = 0; i < MAX_NOTES; i++)
        if(notes[i].state == -1)
        {
          notes[i].on(ch, n, v);
          noteMap[ch][n] = i;
          return;
        }
}

//calculates the wave samples from the parameters
void generateWave()
{
  for(unsigned int i = 0; i < 256; i++)
  {
    unsigned char par = i >> 5;
    unsigned char phase = i & 31;
    short swave = (wavePar[par] << 1) + (((wavePar[(par + 1) & 7] - wavePar[par]) * phase) >> 4);  //linear interpoaltion using some fixed point between this control point and the next
    wave[i] = swave - 128;  //store a signed sample
  }
}

void control(byte ch, byte c, byte v) 
{
  //knob controls to change ADSR (map other controls if you have another device)
  if(c >= 102 && c <= 105)
  {
      adsr[ch][c - 102] = v;
      if(eeprom_is_ready())  //also store to EEPROM
         eeprom_write_byte((uint8_t*)(ch * 4 + c - 102), v);
        
#ifdef GRAPHICS
      setAdsrLines();  //generate new lines
#endif
  }
  
  //Slider controls fore wave shape (map other controls if you have another device)
  if(c >= 110 && c <= 117)
  {
      wavePar[c - 110] = v;
      if(eeprom_is_ready())  //also store to EEPROM
         eeprom_write_byte((uint8_t*)(16 + c - 110), v);
      generateWave();  //interpolate the new wave form
#ifdef GRAPHICS
      setWaveLines();  //generate new lines
#endif
  }  
}

void setup() 
{
  TIMSK0 = 0;  //disable arduino timers
  Serial1.begin(31250);
  //Serial.begin(115200); //for printing debug to PC
  
  DDRC = 255;

#ifdef GRAPHICS
  setupGraphics();
#endif

  TCCR5A = 0;
  TCCR5B = (1 << WGM52) | (1 << CS50); //clear timer on compare (CTC), no prescaling, reset timer after <OCR5A> cycles
  OCR5A = 16000000L / 11025;
  TIMSK5 = (1 << OCIE5A); //enable interrupt on

  for(char j = 0; j < 16; j++)
  {
    for(char i = 0; i < 127; i++)
      noteMap[j][i] = -1;
    //read ADSR prameters from the EEPROM
    for(char i = 0; i < 4; i++)
      adsr[j][i] = eeprom_read_byte((uint8_t*)(j * 4 + i));
  }
#ifdef GRAPHICS
  setAdsrLines();    //calc the ADSR lines
#endif
  for(char i = 0; i < 8; i++)  //read the wave form parameters from the EEPROM
    wavePar[i] = eeprom_read_byte((uint8_t*)(16 + i));
  generateWave();  //interpolate the wave samples from the parameters
#ifdef GRAPHICS
  setWaveLines();  //set the lines to draw from the wave parameters
#endif
}

ISR(TIMER5_COMPA_vect)
{
  short s = 0;
  for(unsigned char i = 0; i < MAX_NOTES; i++)
    if(notes[i].state >= 0)
    {
      s += notes[i].mix();
    }

  PORTC = pgm_read_byte(&compressTab[s + 2048]);
  
  //this part draws the lines. each pixel at a time
#ifdef GRAPHICS
  if(!lineStep() && lineCount)  //draw pixel and check if more
  {
    //precalculate parameters of next line in row
    calcLine(lines[currentLine][0], lines[currentLine][1], lines[currentLine][2], lines[currentLine][3]);
    currentLine++;
    //al lines drwan start from the beginning
    if(currentLine == lineCount)
      currentLine = 0;
  }
#endif
}

unsigned char count;
unsigned char command[2];
void loop() 
{
  while(Serial1.available())
  {
    unsigned char a = Serial1.read();
    //Serial.println(a);
    if(a > 127)
      count = 0;
    else
    {
      if(count == 2)
      {
        if((command[0] & 0xf0) == 0x90)
          noteOn(command[0] & 0xf, command[1], a);
        if((command[0] & 0xf0) == 0x80)
          noteOff(command[0] & 0xf, command[1], a);
        if((command[0] & 0xf0) == 0xb0)              //control change message
          control(command[0] & 0xf, command[1], a);
        }
    }
    if(count < 2)
      command[count] = a;
    count++;
  }
}
